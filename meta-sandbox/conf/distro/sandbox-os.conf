## meta-sandbox/conf/distro/sandbox-os.conf
```bitbake
require conf/distro/poky.conf

DISTRO = "sandbox-os"
DISTRO_NAME = "RockREMOTE Sandbox OS based on Yocto Project"
# Set to 'git describe' by build.sh
DISTRO_VERSION = "v0.0.0"
DISTRO_CODENAME = "sandbox"

# U-Boot to load the kernel
#RPI_USE_U_BOOT = "1"

# Make sure UART is enabled for debug console 
ENABLE_UART = "1"
SERIAL_CONSOLES = "115200;ttyAMA0"

# Enabled i2c
ENABLE_I2C = "1"

# Set the hostname
hostname:pn-base-files = "sandbox"

# Add Systemd
DISTRO_FEATURES:append = " systemd pam ppp wifi usbhost"
VIRTUAL-RUNTIME_init_manager = "systemd"

# Remove sysvinit and its init scripts
DISTRO_FEATURES_BACKFILL_CONSIDERED = "sysvinit"
VIRTUAL-RUNTIME_initscripts = ""

RPI_KERNEL_DEVICETREE = "broadcom/bcm2711-rpi-cm4.dtb"

# Bring in SPI6 4 chip select, UART3 and UART5  DT overlays
RPI_KERNEL_DEVICETREE_OVERLAYS = "\
    overlays/vc4-fkms-v3d.dtbo \
    overlays/uart3.dtbo \
    overlays/uart4.dtbo \
    overlays/uart5.dtbo \
    overlays/i2c1.dtbo \
    overlays/disable-bt.dtbo \
    "
```

## meta-sandbox/conf/layer.conf
```bitbake
# We have a conf and classes directory, add to BBPATH
BBPATH .= ":${LAYERDIR}"

# We have recipes-* directories, add to BBFILES
BBFILES += "${LAYERDIR}/recipes-*/*/*.bb \
            ${LAYERDIR}/recipes-*/*/*.bbappend"

BBFILE_COLLECTIONS += "meta-sandbox"
BBFILE_PATTERN_meta-sandbox = "^${LAYERDIR}/"
BBFILE_PRIORITY_meta-sandbox = "6"

LAYERDEPENDS_meta-sandbox = "core"
LAYERSERIES_COMPAT_meta-sandbox = "kirkstone"
```
